## loader/Kconfig
```kconfig
#
# Copyright (c) Arduino s.r.l. and/or its affiliated companies
#
# SPDX-License-Identifier: Apache-2.0
#

config PINCTRL
	select PINCTRL_NON_STATIC

source "Kconfig.zephyr"

config LLEXT_HEAP_REGION
	string "LLEXT heap memory region"
	depends on CODE_DATA_RELOCATION
	help
	  Specify the memory region for LLEXT heap.

config MAIN_STACK_REGION
	string "Main stack memory region"
	depends on CODE_DATA_RELOCATION
	help
	  Specify the memory region for main stack.

config FLASH_BINARY_PADDING
    int "Flash padding size"
    depends on !LINKER_LAST_SECTION_ID
    help
      Select how the firmware image is padded. Positive values will pad the
      image to the specified size, while negative values will pad the image to
      the Devicetree erase block size. 0 will disable padding.

rsource "ota/Kconfig"
```
